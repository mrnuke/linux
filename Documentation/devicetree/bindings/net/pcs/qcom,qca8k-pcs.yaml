## Documentation/devicetree/bindings/net/pcs/qcom,qca8k-pcs.yaml
```yaml
# SPDX-License-Identifier: GPL-2.0-only OR BSD-2-Clause
%YAML 1.2
---
$id: http://devicetree.org/schemas/net/pcs/qcom,qca8k-pcs.yaml#
$schema: http://devicetree.org/meta-schemas/core.yaml#

title: Qualcomm QCA8386 PCS

maintainers:
  - Luo Jie <quic_luoj@quicinc.com>

description:
  QCA8386 have two PCS devices named as PCS0 and PCS1, which support
  the interface mode SGMII and 2500BASE-X to connect with MAC5 and MAC0.
  They are accessiable over the Ethernet MDIO bus.

properties:
  compatible:
    const: qcom,qca8k-pcs

  reg:
    maxItems: 1

  clocks:
    items:
      - description: PCS system clock
      - description: PCS RX clock
      - description: PCS TX clock

  clock-names:
    items:
      - const: sys
      - const: rx
      - const: tx

  resets:
    items:
      - description: PCS RX reset
      - description: PCS TX reset

  reset-names:
    items:
      - const: rx
      - const: tx

  '#clock-cells':
    const: 1

  clock-output-names:
    maxItems: 2

required:
  - compatible
  - reg
  - clocks
  - clock-names
  - resets
  - reset-names
  - '#clock-cells'
  - clock-output-names

additionalProperties: false

examples:
  - |
    #include <dt-bindings/clock/qcom,qca8k-nsscc.h>
    #include <dt-bindings/reset/qcom,qca8k-nsscc.h>

    mdio {
        #address-cells = <1>;
        #size-cells = <0>;
        pcs1@6 {
            compatible = "qcom,qca8k_pcs";
            reg = <6>;
            clocks = <&qca8k_nsscc NSS_CC_SRDS1_SYS_CLK>,
                     <&qca8k_nsscc NSS_CC_MAC0_RX_SRDS1_CLK>,
                     <&qca8k_nsscc NSS_CC_MAC0_TX_SRDS1_CLK>;
            clock-names = "sys", "rx", "tx";
            resets = <&qca8k_nsscc NSS_CC_MAC0_RX_SRDS1_ARES>,
                     <&qca8k_nsscc NSS_CC_MAC0_TX_SRDS1_ARES>;
            reset-names = "rx", "tx";
            #clock-cells = <0x1>;
            clock-output-names = "qca8k_uniphy_rx",
                                 "qca8k_uniphy_tx";
        };
    };
```

## drivers/net/pcs/Kconfig
```kconfig
# SPDX-License-Identifier: GPL-2.0-only
#
# PCS Layer Configuration
#

menu "PCS device drivers"

config PCS_XPCS
	tristate
	select PHYLINK
	help
	  This module provides helper functions for Synopsys DesignWare XPCS
	  controllers.

config PCS_LYNX
	tristate
	help
	  This module provides helpers to phylink for managing the Lynx PCS
	  which is part of the Layerscape and QorIQ Ethernet SERDES.

config PCS_MTK_LYNXI
	tristate
	select REGMAP
	help
	  This module provides helpers to phylink for managing the LynxI PCS
	  which is part of MediaTek's SoC and Ethernet switch ICs.

config PCS_MTK_USXGMII
	tristate "MediaTek USXGMII PCS"
	select PCS_MTK_LYNXI
	select PHY_MTK_PEXTP
	select PHYLINK
	help
	  This module provides a driver for MediaTek's USXGMII PCS supporting
	  10GBase-R, 5GBase-R and USXGMII interface modes.
	  1000Base-X, 2500Base-X and Cisco SGMII are supported on the same
	  differential pairs via an embedded LynxI PHY.

config PCS_RZN1_MIIC
	tristate "Renesas RZ/N1 MII converter"
	depends on OF && (ARCH_RZN1 || COMPILE_TEST)
	help
	  This module provides a driver for the MII converter that is available
	  on RZ/N1 SoCs. This PCS converts MII to RMII/RGMII or can be set in
	  pass-through mode for MII.

config PCS_QCOM_IPQ_UNIPHY
	tristate "Qualcomm IPQ UNIPHY PCS driver"
	depends on OF && (ARCH_QCOM || COMPILE_TEST)
	depends on HAS_IOMEM
	help
	  This module provides PCS driver for Qualcomm IPQ UNIPHY that is
	  available on Qualcomm IPQ SoCs. The UNIPHY provides both PCS and XPCS
	  functions to support different interface modes for MAC to PHY connections.
	  These modes help to support various combination of ethernet switch/PHY on
	  IPQ SoC based boards.
endmenu
```
